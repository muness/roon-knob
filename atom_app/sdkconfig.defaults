## atom_app/sdkconfig.defaults
```kconfig
CONFIG_IDF_TARGET="esp32s3"
CONFIG_M5_PLATFORM_EXPECT_ATOMS3_JOYSTICK=y
CONFIG_FREERTOS_HZ=1000
CONFIG_PARTITION_TABLE_CUSTOM=y
CONFIG_PARTITION_TABLE_CUSTOM_FILENAME="partitions.csv"
CONFIG_PARTITION_TABLE_FILENAME="partitions.csv"
CONFIG_PARTITION_TABLE_OFFSET=0x8000
CONFIG_PARTITION_TABLE_MD5=y
CONFIG_ESPTOOLPY_FLASHSIZE_8MB=y
CONFIG_ESPTOOLPY_FLASHSIZE="8MB"
CONFIG_COMPILER_OPTIMIZATION_PERF=y
CONFIG_ESP_MAIN_TASK_STACK_SIZE=8192
CONFIG_ESP_SYSTEM_EVENT_TASK_STACK_SIZE=4096
CONFIG_SPIRAM=n
CONFIG_LWIP_LOCAL_HOSTNAME="hiphi-joy"
CONFIG_HTTPD_MAX_REQ_HDR_LEN=2048
CONFIG_ESP_CONSOLE_USB_SERIAL_JTAG=y
CONFIG_PM_ENABLE=y
CONFIG_FREERTOS_USE_TICKLESS_IDLE=y
```

## components/m5_platform/Kconfig
```kconfig
menu "HiPhi M5 platform qualification"

choice M5_PLATFORM_EXPECTED_BOARD
    prompt "Expected physical M5 board"
    default M5_PLATFORM_EXPECT_ANY

config M5_PLATFORM_EXPECT_ANY
    bool "Any supported board"
config M5_PLATFORM_EXPECT_ATOMS3_JOYSTICK
    bool "AtomS3 + Atom JoyStick"
config M5_PLATFORM_EXPECT_TOUGH
    bool "M5Stack Tough"
config M5_PLATFORM_EXPECT_DIAL
    bool "M5 Dial"
config M5_PLATFORM_EXPECT_STICKS3
    bool "M5StickS3"
config M5_PLATFORM_EXPECT_STOPWATCH
    bool "M5Stack StopWatch"
config M5_PLATFORM_EXPECT_STACKCHAN
    bool "M5StackChan"
endchoice

config M5_PLATFORM_STACKCHAN_VOICE_WS_URI
    string "StackChan LAN voice WebSocket URI"
    depends on M5_PLATFORM_EXPECT_STACKCHAN
    default ""
    help
        Versioned UHC voice gateway used after on-device wake detection.
        Leave empty to keep voice disabled. Example:
        ws://192.168.1.10:8088/voice/v1

config M5_PLATFORM_ENROLLMENT_WS_URI
    string "Independent wake-word enrollment WebSocket URI"
    default ""
    help
        Full URL of the standalone training service. This endpoint is never
        derived from, or assumed to share a host with, the production voice
        gateway. Leave empty outside directed enrollment work.

config M5_PLATFORM_DEVICE_ID
    string "Microphone device instance ID"
    default "hiphi-device"

config M5_PLATFORM_DEVICE_PROFILE
    string "Microphone acoustic device profile"
    default "m5stack_stackchan_k151_cores3_room_scale_v2" if M5_PLATFORM_EXPECT_STACKCHAN
    default "unqualified"
    help
        Identifies equivalent microphone hardware and preprocessing, not one
        physical unit. Targets without an implemented and qualified enrollment
        path must not claim another product's acoustic profile.

endmenu
```

## components/rk_ble_hid_host/Kconfig
```kconfig
menu "Shared BLE HID host"

config RK_BLE_HID_HOST
    bool "Enable BLE HID media-remote host"
    depends on IDF_TARGET_ESP32S3 && BT_ENABLED && BT_NIMBLE_ENABLED && BT_NIMBLE_NVS_PERSIST && BT_NIMBLE_SM_SC && BT_NIMBLE_HID_SERVICE
    default n
    help
        Enable the NimBLE HOGP host used to receive media keys from a paired
        BLE remote. This is a host capability, not the legacy HID peripheral
        profile. Targets choose their local default at runtime.

endmenu
```

## frame_app/main/Kconfig.projbuild
```kconfig
menu "hiphi-frame Defaults"

config RK_DEFAULT_SSID
    string "Default WiFi SSID"
    default ""

config RK_DEFAULT_PASS
    string "Default WiFi Password"
    default ""

config RK_DEFAULT_BRIDGE_BASE
    string "Default Bridge Base URL (leave empty for mDNS discovery)"
    default ""

config RK_FRAME_DEEP_SLEEP
    bool "Enable fail-awake Frame ESP32-S3 Deep-sleep policy"
    default n
    help
        Enables the Frame-owned stopped-zone Deep-sleep policy. The exact
        Frame profile opts in explicitly; unknown PMIC state, active playback,
        provisioning, pending e-ink work, and wake setup failures stay awake.

endmenu
```

## knob_aux_app/sdkconfig.defaults
```kconfig
CONFIG_IDF_TARGET="esp32"
CONFIG_IDF_TARGET_ESP32=y

CONFIG_COMPILER_OPTIMIZATION_PERF=y
CONFIG_ESPTOOLPY_FLASHSIZE_4MB=y
CONFIG_ESPTOOLPY_FLASHMODE_DIO=y
CONFIG_ESPTOOLPY_FLASHFREQ_40M=y
CONFIG_PARTITION_TABLE_SINGLE_APP=y

CONFIG_BOOTLOADER_LOG_LEVEL_NONE=y
CONFIG_LOG_DEFAULT_LEVEL_NONE=y
CONFIG_LOG_MAXIMUM_EQUALS_DEFAULT=y
```

## official_components/m5_official/sdkconfig.defaults
```kconfig
# Compile the official Arduino runtime plus Wire only. The published component
# defaults every optional Arduino library on, although these M5Stack board
# libraries do not use them.
CONFIG_ARDUINO_SELECTIVE_COMPILATION=y
# CONFIG_ARDUINO_SELECTIVE_SPI is not set
CONFIG_ARDUINO_SELECTIVE_Wire=y
# CONFIG_ARDUINO_SELECTIVE_ESP_SR is not set
# CONFIG_ARDUINO_SELECTIVE_ESP_Video is not set
# CONFIG_ARDUINO_SELECTIVE_EEPROM is not set
# CONFIG_ARDUINO_SELECTIVE_Preferences is not set
# CONFIG_ARDUINO_SELECTIVE_Ticker is not set
# CONFIG_ARDUINO_SELECTIVE_Update is not set
# CONFIG_ARDUINO_SELECTIVE_Zigbee is not set
# CONFIG_ARDUINO_SELECTIVE_FS is not set
# CONFIG_ARDUINO_SELECTIVE_SD is not set
# CONFIG_ARDUINO_SELECTIVE_SD_MMC is not set
# CONFIG_ARDUINO_SELECTIVE_SPIFFS is not set
# CONFIG_ARDUINO_SELECTIVE_FFat is not set
# CONFIG_ARDUINO_SELECTIVE_LittleFS is not set
# CONFIG_ARDUINO_SELECTIVE_Network is not set
# CONFIG_ARDUINO_SELECTIVE_Ethernet is not set
# CONFIG_ARDUINO_SELECTIVE_PPP is not set
# CONFIG_ARDUINO_SELECTIVE_Hash is not set
# CONFIG_ARDUINO_SELECTIVE_ArduinoOTA is not set
# CONFIG_ARDUINO_SELECTIVE_AsyncUDP is not set
# CONFIG_ARDUINO_SELECTIVE_DNSServer is not set
# CONFIG_ARDUINO_SELECTIVE_ESPmDNS is not set
# CONFIG_ARDUINO_SELECTIVE_HTTPClient is not set
# CONFIG_ARDUINO_SELECTIVE_Matter is not set
# CONFIG_ARDUINO_SELECTIVE_NetBIOS is not set
# CONFIG_ARDUINO_SELECTIVE_WebServer is not set
# CONFIG_ARDUINO_SELECTIVE_WiFi is not set
# CONFIG_ARDUINO_SELECTIVE_NetworkClientSecure is not set
# CONFIG_ARDUINO_SELECTIVE_WiFiProv is not set
# CONFIG_ARDUINO_SELECTIVE_BLE is not set
# CONFIG_ARDUINO_SELECTIVE_BluetoothSerial is not set
# CONFIG_ARDUINO_SELECTIVE_SimpleBLE is not set
# CONFIG_ARDUINO_SELECTIVE_RainMaker is not set
# CONFIG_ARDUINO_SELECTIVE_OpenThread is not set
# CONFIG_ARDUINO_SELECTIVE_Insights is not set
```

## rlcd_app/main/Kconfig.projbuild
```kconfig
menu "HiPhi RLCD Defaults"

config RK_RLCD_DEEP_SLEEP
    bool "Enable fail-awake RLCD ESP32-S3 Deep-sleep policy"
    default y
    help
        After the configured battery idle timeout, quiesce BLE and Wi-Fi,
        put the ST7305 into Sleep In, and enter ESP32-S3 Deep-sleep. GPIO18
        KEY wakes the exact Waveshare ESP32-S3-RLCD-4.2 target.

endmenu
```

## rlcd_app/sdkconfig.defaults
```kconfig
CONFIG_IDF_TARGET="esp32s3"
CONFIG_PARTITION_TABLE_CUSTOM=y
CONFIG_PARTITION_TABLE_CUSTOM_FILENAME="partitions.csv"
CONFIG_ESPTOOLPY_FLASHSIZE_16MB=y
CONFIG_ESPTOOLPY_FLASHMODE_QIO=y
CONFIG_COMPILER_OPTIMIZATION_PERF=y
CONFIG_LV_FONT_MONTSERRAT_16=y
CONFIG_LV_FONT_MONTSERRAT_20=y
CONFIG_LV_BUILD_EXAMPLES=n
CONFIG_LV_BUILD_DEMOS=n
CONFIG_ESP_MAIN_TASK_STACK_SIZE=8192
CONFIG_SPIRAM=y
CONFIG_SPIRAM_MODE_OCT=y
CONFIG_SPIRAM_SPEED_80M=y
CONFIG_SPIRAM_BOOT_INIT=y
CONFIG_SPIRAM_USE_MALLOC=y
CONFIG_SPIRAM_MALLOC_ALWAYSINTERNAL=16384
CONFIG_SPIRAM_TRY_ALLOCATE_WIFI_LWIP=y
CONFIG_SPIRAM_ALLOW_BSS_SEG_EXTERNAL_MEMORY=y
CONFIG_FREERTOS_TASK_CREATE_ALLOW_EXT_MEM=y
CONFIG_ESP_WIFI_STATIC_RX_BUFFER_NUM=6
CONFIG_ESP_WIFI_DYNAMIC_RX_BUFFER_NUM=16
CONFIG_ESP_WIFI_STATIC_TX_BUFFER_NUM=8
CONFIG_ESP_WIFI_TX_BUFFER_TYPE=1
CONFIG_ESP_WIFI_DYNAMIC_TX_BUFFER_NUM=16
CONFIG_ESP_WIFI_RX_BA_WIN=6
CONFIG_ESP_WIFI_MGMT_SBUF_NUM=16
CONFIG_ESP_SYSTEM_EVENT_TASK_STACK_SIZE=4096
CONFIG_HTTPD_MAX_REQ_HDR_LEN=2048
CONFIG_ESP_CONSOLE_UART_DEFAULT=y
CONFIG_PM_ENABLE=y
CONFIG_PM_DFS_INIT_AUTO=y
CONFIG_FREERTOS_USE_TICKLESS_IDLE=y
CONFIG_RK_BLE_HID_HOST=y
CONFIG_RK_RLCD_DEEP_SLEEP=y
CONFIG_BT_ENABLED=y
CONFIG_BT_NIMBLE_ENABLED=y
CONFIG_BT_NIMBLE_NVS_PERSIST=y
CONFIG_BT_NIMBLE_SM_SC=y
CONFIG_BT_NIMBLE_HID_SERVICE=y
CONFIG_BT_NIMBLE_MEM_ALLOC_MODE_EXTERNAL=y
CONFIG_BT_NIMBLE_PINNED_TO_CORE_0=y
CONFIG_BT_NIMBLE_ROLE_CENTRAL=y
CONFIG_BT_NIMBLE_ROLE_OBSERVER=y
CONFIG_BT_NIMBLE_ROLE_PERIPHERAL=y
CONFIG_BT_NIMBLE_ROLE_BROADCASTER=n
CONFIG_BT_NIMBLE_GATT_CLIENT=y
CONFIG_BT_NIMBLE_GATT_SERVER=y
CONFIG_BT_NIMBLE_MAX_BONDS=2
CONFIG_BT_NIMBLE_MAX_CONNECTIONS=1
CONFIG_BT_NIMBLE_MAX_CCCDS=2
CONFIG_BT_NIMBLE_ATT_PREFERRED_MTU=128
CONFIG_BT_NIMBLE_ATT_MAX_PREP_ENTRIES=4
CONFIG_BT_NIMBLE_GATT_MAX_PROCS=2
CONFIG_BT_NIMBLE_MSYS_1_BLOCK_COUNT=6
CONFIG_BT_NIMBLE_MSYS_1_BLOCK_SIZE=128
CONFIG_BT_NIMBLE_MSYS_2_BLOCK_COUNT=8
CONFIG_BT_NIMBLE_MSYS_2_BLOCK_SIZE=192
CONFIG_BT_NIMBLE_TRANSPORT_ACL_FROM_LL_COUNT=8
CONFIG_BT_NIMBLE_TRANSPORT_ACL_SIZE=128
CONFIG_BT_NIMBLE_TRANSPORT_EVT_COUNT=10
CONFIG_BT_NIMBLE_TRANSPORT_EVT_DISCARD_COUNT=4
```
