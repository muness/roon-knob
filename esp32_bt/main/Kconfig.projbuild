## esp32_bt/main/Kconfig.projbuild
```kconfig
menu "ESP32 Bluetooth Configuration"

    config ESP32_BT_DEVICE_NAME
        string "Bluetooth device name"
        default "Roon Knob BT"
        help
            Name shown when pairing with phones/devices.

    config ESP32_UART_TX_PIN
        int "UART TX GPIO (to S3)"
        default 13
        help
            GPIO pin for UART TX to ESP32-S3.

    config ESP32_UART_RX_PIN
        int "UART RX GPIO (from S3)"
        default 23
        help
            GPIO pin for UART RX from ESP32-S3.

    config ESP32_UART_BAUD
        int "UART baud rate"
        default 1000000
        help
            Baud rate for inter-chip communication.

endmenu
```

## esp32_bt/sdkconfig.defaults
```kconfig
# ESP32 Bluetooth Firmware Configuration
# Target: ESP32 (not S3)

# Target chip
CONFIG_IDF_TARGET="esp32"

# Bluetooth - Dual mode (Classic BT + BLE)
# Classic: AVRCP for playback control, A2DP for phone compatibility
# BLE: HID for volume control (works on phones and DAPs)
CONFIG_BT_ENABLED=y
CONFIG_BT_BLUEDROID_ENABLED=y
CONFIG_BT_CLASSIC_ENABLED=y
CONFIG_BT_A2DP_ENABLE=y
CONFIG_BT_SPP_ENABLED=n
CONFIG_BT_BLE_ENABLED=y
CONFIG_BTDM_CTRL_MODE_BTDM=y

# AVRCP Controller (for media controls and metadata)
CONFIG_BT_AVRC_CT_ENABLED=y

# BLE GATT server for HID
CONFIG_BT_GATTS_ENABLE=y

# Bluetooth device name
CONFIG_BT_DEV_NAME="Roon Knob BT"

# Logging
CONFIG_LOG_DEFAULT_LEVEL_INFO=y
CONFIG_LOG_MAXIMUM_LEVEL_DEBUG=y

# UART
CONFIG_UART_ISR_IN_IRAM=y

# Flash size (typical ESP32-WROOM)
CONFIG_ESPTOOLPY_FLASHSIZE_4MB=y

# Partition table
CONFIG_PARTITION_TABLE_CUSTOM=y
CONFIG_PARTITION_TABLE_CUSTOM_FILENAME="partitions.csv"

# FreeRTOS
CONFIG_FREERTOS_HZ=1000

# Watchdog
CONFIG_ESP_TASK_WDT_TIMEOUT_S=10
```

## esp_dial/Kconfig.projbuild
```kconfig
menu "Roon Knob Configuration"

    config ROON_KNOB_BLE_HID_ENABLED
        bool "Enable BLE HID mode (Bluetooth media controller)"
        default n
        help
            Enable Bluetooth Low Energy HID mode as an alternative/fallback
            to WiFi Roon control. When enabled, the device can act as a
            universal Bluetooth media remote for phones, laptops, and TVs.

            Note: Enabling this increases firmware size by ~100KB and
            requires additional RAM for the Bluetooth stack.

    config ROON_KNOB_BLE_DEVICE_NAME
        string "BLE device name"
        default "Roon Knob"
        depends on ROON_KNOB_BLE_HID_ENABLED
        help
            The name advertised when in BLE HID mode.

endmenu
```

## esp_dial/main/Kconfig.projbuild
```kconfig
menu "Roon-Knob Defaults"

config RK_DEFAULT_SSID
    string "Default WiFi SSID"
    default ""

config RK_DEFAULT_PASS
    string "Default WiFi Password"
    default ""

config RK_DEFAULT_BRIDGE_BASE
    string "Default Bridge Base URL (leave empty to require mDNS or manual config)"
    default ""

endmenu

menu "Display Sleep Settings"

config RK_DISPLAY_DIM_TIMEOUT_SEC
    int "Display dim timeout (seconds)"
    default 30
    range 5 300
    help
        Time in seconds before dimming the display backlight.
        Set to 0 to disable dimming.

config RK_DISPLAY_SLEEP_TIMEOUT_SEC
    int "Display sleep timeout (seconds)"
    default 60
    range 10 600
    help
        Time in seconds before turning off the display completely.
        Set to 0 to disable sleep.

config RK_BACKLIGHT_NORMAL
    int "Normal backlight brightness (0-255)"
    default 100
    range 0 255
    help
        Backlight brightness level during normal operation (0-255).
        Default 100 is approximately 40% brightness.

config RK_BACKLIGHT_DIM
    int "Dimmed backlight brightness (0-255)"
    default 25
    range 0 255
    help
        Backlight brightness level when dimmed (0-255).
        Default 25 is approximately 10% brightness.

endmenu
```

## esp_dial/sdkconfig.defaults.ble
```kconfig
# BLE HID Configuration
# Include this file when building with BLE support:
#   idf.py -DSDKCONFIG_DEFAULTS="sdkconfig.defaults;sdkconfig.defaults.ble" build

# Enable BLE HID mode in Roon Knob
CONFIG_ROON_KNOB_BLE_HID_ENABLED=y

# Bluetooth Controller
CONFIG_BT_ENABLED=y
CONFIG_BT_CONTROLLER_ENABLED=y

# Bluedroid Stack
CONFIG_BT_BLUEDROID_ENABLED=y
CONFIG_BT_BLE_ENABLED=y

# GATT Server (required for HID)
CONFIG_BT_GATTS_ENABLE=y
CONFIG_BT_GATT_MAX_SR_PROFILES=8
CONFIG_BT_GATT_MAX_SR_ATTRIBUTES=100

# Security (for pairing)
CONFIG_BT_BLE_SMP_ENABLE=y

# Release Classic BT memory (we only use BLE)
CONFIG_BT_CLASSIC_ENABLED=n

# Reduce log verbosity for BT
CONFIG_BT_LOG_HCI_TRACE_LEVEL_WARNING=y
CONFIG_BT_LOG_BTM_TRACE_LEVEL_WARNING=y
CONFIG_BT_LOG_L2CAP_TRACE_LEVEL_WARNING=y
CONFIG_BT_LOG_SMP_TRACE_LEVEL_WARNING=y
CONFIG_BT_LOG_GATT_TRACE_LEVEL_WARNING=y
```

## idf_app/main/Kconfig.projbuild
```kconfig
menu "Roon-Knob Defaults"

config RK_DEFAULT_SSID
    string "Default WiFi SSID"
    default ""

config RK_DEFAULT_PASS
    string "Default WiFi Password"
    default ""

config RK_DEFAULT_BRIDGE_BASE
    string "Default Bridge Base URL"
    default "http://192.168.1.213:8088"

endmenu

menu "Display Sleep Settings"

config RK_DISPLAY_DIM_TIMEOUT_SEC
    int "Display dim timeout (seconds)"
    default 30
    range 5 300
    help
        Time in seconds before dimming the display backlight.
        Set to 0 to disable dimming.

config RK_DISPLAY_SLEEP_TIMEOUT_SEC
    int "Display sleep timeout (seconds)"
    default 60
    range 10 600
    help
        Time in seconds before turning off the display completely.
        Set to 0 to disable sleep.

config RK_BACKLIGHT_NORMAL
    int "Normal backlight brightness (0-255)"
    default 100
    range 0 255
    help
        Backlight brightness level during normal operation (0-255).
        Default 100 is approximately 40% brightness.

config RK_BACKLIGHT_DIM
    int "Dimmed backlight brightness (0-255)"
    default 25
    range 0 255
    help
        Backlight brightness level when dimmed (0-255).
        Default 25 is approximately 10% brightness.

endmenu

menu "Roon Knob Bluetooth Settings"

config ROON_KNOB_BLUETOOTH_MODE
    bool "Enable Bluetooth mode (via ESP32 chip)"
    default y
    help
        Enable Bluetooth mode as an alternative to WiFi Roon control.
        Uses the ESP32 chip (via UART) for BLE HID + AVRCP.
        When enabled, "Bluetooth" appears in the zone picker.

endmenu
```
